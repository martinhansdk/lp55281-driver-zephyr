## drivers/led/Kconfig
```kconfig
# Copyright (c) 2023 Phytec Messtechnik GmbH
# SPDX-License-Identifier: Apache-2.0

config LP55281
	bool "LP55281 LED driver"
	default y
	depends on DT_HAS_TI_LP55281_ENABLED
	select I2C
	help
	  Enable LED driver for LP55281. LP55281 LED driver has 12 channels.
	  Each channel can drive up to 40 mA per LED. This driver supports SPI for control.
```

## dts/bindings/ti,lp55281.yaml
```yaml
description: TI LP55281 LED

compatible: "ti,lp55281"

include: ["spi-device.yaml", "led-controller.yaml"]

properties:

  boost-frequency:
    type: int
    default: 2000000
    description: The boost converter frequency. 0 disables the boost converter.
    enum:
      - 0
      - 1000000
      - 1670000
      - 2000000

  pwm-frequency:
    type: int
    default: 10000
    description: The PWM frequency in Hz.
    enum:
      - 10000
      - 20000
      - 40000

  boost-voltage:
    type: int
    default: 5000
    description: The boost voltage in mV.
    enum:
      - 4000
      - 4250
      - 4400
      - 4550
      - 4700
      - 4850
      - 5000
      - 5150
      - 5300
  
  autoload:
    type: boolean
    description: "Disabling increases the efficiency at light loads, but the downside is that pulse skipping will occur. The boost converter must be stopped when there is no load to
minimize the current consumption."

child-binding:
  properties:
    label:
      required: true
    index:
      required: true
    color-mapping:
      required: true
    led-current:
      default: [3, 3, 3]
      type: array
      description: "The current setting to use for each color in percentage of the maximum current. 0=25% of max, 1=50% of max, 2=75% of max, 3=max"
```
